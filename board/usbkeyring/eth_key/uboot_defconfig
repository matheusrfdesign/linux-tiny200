## board/usbkeyring/eth_key/uboot_defconfig
```kconfig
CONFIG_ARM=y
CONFIG_ARCH_SUNXI=y
CONFIG_SYS_TEXT_BASE=0x81700000
CONFIG_ENV_SIZE=0x8000
CONFIG_SPL=y
CONFIG_MACH_SUNIV=y
CONFIG_DRAM_CLK=156
CONFIG_DRAM_ZQ=0
CONFIG_BOOTDELAY=0
CONFIG_BOOTCOMMAND="setenv bootargs console=ttyS0,115200 root=/dev/mmcblk0p2 rootwait; fatload mmc 0 ${kernel_addr_r} zImage; fatload mmc 0 ${fdt_addr_r} usbkeyring.dtb; bootz ${kernel_addr_r} - ${fdt_addr_r}"
CONFIG_USE_PREBOOT=y
CONFIG_DEFAULT_DEVICE_TREE="usbkeyring"
```
